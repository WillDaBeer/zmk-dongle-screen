## Kconfig
```kconfig
DT_COMPAT_ZMK_BEHAVIOR_CAPS_WORD_IND := zmk,behavior-caps-word-ind

config ZMK_BEHAVIOR_CAPS_WORD_IND
        bool
        default $(dt_compat_enabled,$(DT_COMPAT_ZMK_BEHAVIOR_CAPS_WORD_IND))
```

## dts/bindings/behaviors/zmk,behavior-caps-word-ind.yaml
```yaml
# Copyright (c) 2021 The ZMK Contributors
# SPDX-License-Identifier: MIT

description: Caps word behavior with a dongle-screen state flag

compatible: "zmk,behavior-caps-word-ind"

include: zero_param.yaml

properties:
  continue-list:
    type: array
    required: true
  mods:
    type: int
```
